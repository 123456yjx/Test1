#include "string.h"
#include "bsp_crc16.h"




u8 Send_Statflag=0;
typedef  unsigned  char  uint8_t;
typedef  unsigned  short  uint16_t;

const uint8_t g_u8CRCHiTb[256] = {
	0x00, 0xC1, 0x81, 0x40, 0x01, 0xC0, 0x80, 0x41, 0x01, 0xC0,
	0x80, 0x41, 0x00, 0xC1, 0x81, 0x40, 0x01, 0xC0, 0x80, 0x41,
	0x00, 0xC1, 0x81, 0x40, 0x00, 0xC1, 0x81, 0x40, 0x01, 0xC0,
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	0x80, 0x41, 0x00, 0xC1, 0x81, 0x40
};

const uint8_t g_u8CRCLoTb[256] = {
	0x00, 0xC0, 0xC1, 0x01, 0xC3, 0x03, 0x02, 0xC2, 0xC6, 0x06,
	0x07, 0xC7, 0x05, 0xC5, 0xC4, 0x04, 0xCC, 0x0C, 0x0D, 0xCD,
	0x0F, 0xCF, 0xCE, 0x0E, 0x0A, 0xCA, 0xCB, 0x0B, 0xC9, 0x09,
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	0x43, 0x83, 0x41, 0x81, 0x80, 0x40
};

uint16_t CRC16(const uint8_t *u8PtrMsg, uint16_t u16DataLen) {
	uint8_t l_u8CRCHi = 0xFF ;
	uint8_t l_u8CRCLo = 0xFF ;
	uint8_t l_u8Index ;
	while (u16DataLen--) {
		l_u8Index = l_u8CRCHi ^ *u8PtrMsg++ ;
		l_u8CRCHi = l_u8CRCLo ^ g_u8CRCHiTb[l_u8Index] ;
		l_u8CRCLo = g_u8CRCLoTb[l_u8Index] ;
	}
	return (l_u8CRCHi << 8 | l_u8CRCLo) ;
}
 
/**********************************************************************************
* 函数名  : Modbus_ReceiveData
* 描述    : 接收串口1收到的数据
* 输入    : u8PtrMsg数据，u16DataLen数据长度
* 返回    : 无 
* 说明    : 接收串口收到的数据
*********************************************************************************/
void Parameter_ReceiveData(void)
{
	int Data=0;
  u8 i;	
	unsigned char u8PtrMsg_buf[9]={0x00};
	unsigned char data_buf[4]={0x00};
	
	if(buf2_cnt==9)       /*判断有数据接收*/
	{			
			for(i=0;i<9;i++)    /*将接收到的数据保存在数组u8PtrMsg_buf中*/
			{
					 u8PtrMsg_buf[i]=Uart2_Buf[i];
			}		
			CLR_Buf2();                      /*清空串口接收到的数据*/   
		  if(u8PtrMsg_buf[0]==0xAA&&u8PtrMsg_buf[8]==0x55) /*查找帧头和尾帧，一帧数据结束标志，*/
			{
					for(i=0;i<4;i++)                      /*获取数据位*/
					{
							data_buf[i]=u8PtrMsg_buf[i+2];
					}
					if(CRC16(data_buf,4)==u8PtrMsg_buf[6]*256+u8PtrMsg_buf[7])/*比较校验位,比对成功获取*/
					{		
  						Send_Statflag=1;	/*接收数据的标志位置1*/
	    				Data=data_buf[0]*16777216+data_buf[1]*65536+data_buf[2]*256+data_buf[3];
						   
							if(((u8PtrMsg_buf[1]==1)||(u8PtrMsg_buf[1]==2)||(u8PtrMsg_buf[1]==3))&&PageNum.NUM_1==FlagTure) //第一页为电压参数	
		          {
								if(Data>4090&&Data!=0xFFFFFF)
									{
													Voltage_DataPage_Menu(u8PtrMsg_buf[1],Data);
								  }else{
													Voltage_DataPage_Menu(u8PtrMsg_buf[1],0);
									}
													PageNum.NUM_1=FlagFalse;
		          }
		         else if(((u8PtrMsg_buf[1]==4)||(u8PtrMsg_buf[1]==5)||(u8PtrMsg_buf[1]==6))&&(PageNum.NUM_2==FlagTure))//第二页为电流参数
		          {
								if(Data>255&&Data!=16777215)
									{
													ElectricCurrent_Power_Menu(u8PtrMsg_buf[1],Data);
									}else{
													ElectricCurrent_Power_Menu(u8PtrMsg_buf[1],0);
									}
													PageNum.NUM_2=FlagFalse;
		          }		
	          else if(((u8PtrMsg_buf[1]==7)||(u8PtrMsg_buf[1]==8)||(u8PtrMsg_buf[1]==9)||(u8PtrMsg_buf[1]==0x0A))&&(PageNum.NUM_3==FlagTure))//第三页为有功功率参数
	          	{   if(Data!=0&&Data!=16777215)
								  {
													ActivePower_Menu(u8PtrMsg_buf[1],Data);
								  }else{
													ActivePower_Menu(u8PtrMsg_buf[1],0);
									}
													PageNum.NUM_3=FlagFalse;
	          	}
	          	else if(((u8PtrMsg_buf[1]==0x0B)||(u8PtrMsg_buf[1]==0x0C)||(u8PtrMsg_buf[1]==0x0D)||(u8PtrMsg_buf[1]==0x0E))&&(PageNum.NUM_4==FlagTure))//第四页为无功功率，存在负值0.070var
	          	{
								   if(Data!=0&&Data!=16777215)
								  {
													ReactivePower_Menu(u8PtrMsg_buf[1],Data);
									}else{
													ReactivePower_Menu(u8PtrMsg_buf[1],0);
									}
													PageNum.NUM_4=FlagFalse;
	          	}
	          else  if(((u8PtrMsg_buf[1]==0x0F)||(u8PtrMsg_buf[1]==0x10)||(u8PtrMsg_buf[1]==0x11)||(u8PtrMsg_buf[1]==0x012))&&(PageNum.NUM_5==FlagTure))//第五页为视在功率参数
	          	{
									 if(Data!=0&&Data!=16777215)
								  {
													ApparentPower_Menu(u8PtrMsg_buf[1],Data);
									}else{
													ApparentPower_Menu(u8PtrMsg_buf[1],0);
									}
													PageNum.NUM_5=FlagFalse;
	          	}
	          	else if(((u8PtrMsg_buf[1]==0x13)||(u8PtrMsg_buf[1]==0x14)||(u8PtrMsg_buf[1]==0x15))&&(PageNum.NUM_6==FlagTure))//第六页为功率因数
	          	{
								  if(Data!=8388608&&Data!=16777215)
									{
													PowerFactor_Menu(u8PtrMsg_buf[1],Data);
									}else{
													PowerFactor_Menu(u8PtrMsg_buf[1],0);
									}
													PageNum.NUM_6=FlagFalse;
	          	}
		          else if(((u8PtrMsg_buf[1]==0x16)||(u8PtrMsg_buf[1]==0x17)||(u8PtrMsg_buf[1]==0x18)||(u8PtrMsg_buf[1]==0x19))&&(PageNum.NUM_7==FlagTure)) //第七页为有功电能参数
	          	{
								  if(Data!=0&&Data!=16777215)
							  	{
													ActiveEnergy_Menu(u8PtrMsg_buf[1],Data);
								  }else{
													ActiveEnergy_Menu(u8PtrMsg_buf[1],0);
									}	
													PageNum.NUM_7=FlagFalse;
	          	}
          	else	if(((u8PtrMsg_buf[1]==0x1A)||(u8PtrMsg_buf[1]==0x1B)||(u8PtrMsg_buf[1]==0x1C)||(u8PtrMsg_buf[1]==0x1D))&&(PageNum.NUM_8==FlagTure))//第八页为无功电能
          		{
								   if(Data!=0&&Data!=16777215)
									 {
													ReactiveEnergy_Menu(u8PtrMsg_buf[1],Data);						  
									 }else{
													ReactiveEnergy_Menu(u8PtrMsg_buf[1],0);	
									 }
									 					  
													PageNum.NUM_8=FlagFalse;
	          	}
							else if(u8PtrMsg_buf[1]==0x1E)
               {
							    DamageEx_Menu(Data);
							 }							
	   		  }										
		   }			
		}
}	
	   		


/*******************************************************************************
* 函数名 : Modbus_SendData
* 描述   : 接收串口收到的数据函数
* 输入   : Package_type传递包类型，Data_Msg传递数据区
* 输出   : void
* 返回   : 
* 注意   : 
*******************************************************************************/
void Parameter_SendData(uint8_t Package_type ,uint16_t Data_Msg)
{
  unsigned char Send_Data[7];/*数据的缓存器*/
	unsigned char buf[2];//数据区的缓存区
	int i;

	if(Send_Statflag==1)
	{
		  Send_Statflag=0;
			Send_Data[0]=0xAA;//帧头数据
			Send_Data[1]=Package_type;
			Send_Data[2]=Data_Msg>>8;
			Send_Data[3]=Data_Msg&0xff;
			for(i=0;i<2;i++)/*获取数据区的数据,得到校验位*/
			{
				  buf[i]=Send_Data[i+2];
			}
			Send_Data[4]=CRC16(buf,2)>>8;//取CRC的高八位
			Send_Data[5]=CRC16(buf,2)&0xFF;//取CRC的低八位
			Send_Data[6]=0x55;
			Usart_SendArray(USART2,Send_Data,7);//串口1发送数据
	}  
}



void HexToBinstr(int hex, char *bin_str,int str_size)
{
	int i;
	for(i=0;i!=8;++i)
	{
			bin_str[str_size-1-i]=hex%2+'0';
		hex/=2;
	}
}

